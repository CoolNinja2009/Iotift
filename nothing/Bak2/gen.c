// Generated by IOTIFT - ESP32 Arduino Production Ready
// Target: rpi_pico

#include <stdio.h>
#include <stdint.h>
#include <stdlib.h>


// ────────── Pin Definitions ──────────
#define LED_PIN 12
#define BTN_PIN 5


// ────────── Global State ──────────
int x = 0;
int y = 5;
unsigned long _every_0_last = 0;
int _last_BTN_state = HIGH;


// ────────── Handlers ──────────
void handle_every_0() {
  unsigned long now = millis();
  if (now - _every_0_last >= 1000UL) {
      _every_0_last = now;
      x += 1;
      if ((x > 2)) {
        if ((x < 10)) {
          digitalWrite(LED_PIN, HIGH);
          if (((x % 2) == 0)) {
            schedule_after(LED_PIN, 0, 200);
            if ((x > 4)) {
              schedule_after(LED_PIN, 1, 400);
            }
            else {
              schedule_after(LED_PIN, 0, 300);
            }
          }
          else {
            if ((x == 5)) {
              digitalWrite(LED_PIN, HIGH);
            }
            else {
              digitalWrite(LED_PIN, LOW);
            }
          }
        }
        else {
          if ((x >= 10)) {
            digitalWrite(LED_PIN, LOW);
          }
        }
      }
      else {
        if ((y == 5)) {
          digitalWrite(LED_PIN, HIGH);
        }
        else {
          digitalWrite(LED_PIN, LOW);
        }
      }
  }
}

void handle_BTN_press() {
  int _state = digitalRead(BTN_PIN);
  if (_state == LOW && _last_BTN_state == HIGH) {
      if ((x > 3)) {
        if ((x < 8)) {
          digitalWrite(LED_PIN, HIGH);
          if ((y == 5)) {
            schedule_after(LED_PIN, 0, 100);
          }
          else {
            schedule_after(LED_PIN, 1, 200);
          }
        }
        else {
          digitalWrite(LED_PIN, LOW);
        }
      }
      else {
        digitalWrite(LED_PIN, HIGH);
      }
  }
  _last_BTN_state = _state;
}


// ────────── User Functions ──────────
void user_loop() {
  if ((x > 15)) {
    if ((x < 20)) {
      printf("%d\n", "mid range");
      if ((x == 17)) {
        printf("%d\n", "exact 17");
      }
      else {
        printf("%d\n", "not 17");
      }
    }
    else {
      printf("%d\n", "high value");
    }
  }
  else {
    printf("%d\n", "low value");
  }
}


// ────────── Setup ──────────
void setup() {
  pinMode(LED_PIN, OUTPUT);
  pinMode(BTN_PIN, INPUT_PULLUP);
  _every_0_last = millis();
}


// ────────── Main Loop ──────────
void loop() {
  handle_every_0();
  handle_BTN_press();
  user_loop();
}
