// Generated by IOTIFT - ESP32 Arduino Production Ready
// Target: esp32

#include "Arduino.h"


// ────────── Pin Definitions ──────────
#define LED_PIN 2


// ────────── Global State ──────────
unsigned long _every_0_last = 0;


// ────────── Scheduler for after ──────────
struct ScheduledTask {
  unsigned long trigger_time;
  int pin;
  int value;
  int active;
};
ScheduledTask scheduler[16];

void schedule_after(int pin, int value, unsigned long ms) {
  for (int i = 0; i < 16; i++) {
    if (!scheduler[i].active) {
      unsigned long now = millis();
      scheduler[i].trigger_time = now + ms;
      scheduler[i].pin = pin;
      scheduler[i].value = value;
      scheduler[i].active = 1;
      return;
    }
  }
}

void check_scheduler() {
  unsigned long now = millis();
  for (int i = 0; i < 16; i++) {
    if (scheduler[i].active && now >= scheduler[i].trigger_time) {
      digitalWrite(scheduler[i].pin, scheduler[i].value ? HIGH : LOW);
      scheduler[i].active = 0;
    }
  }
}


// ────────── Handlers ──────────
void handle_every_0() {
  unsigned long now = millis();
  if (now - _every_0_last >= 1000UL) {
      _every_0_last = now;
      digitalWrite(LED_PIN, HIGH);
      schedule_after(LED_PIN, 0, 500);
  }
}


// ────────── Setup ──────────
void setup() {
  Serial.begin(115200);
  pinMode(LED_PIN, OUTPUT);
  _every_0_last = millis();
}


// ────────── Main Loop ──────────
void loop() {
  handle_every_0();
  check_scheduler();
  yield();
}
