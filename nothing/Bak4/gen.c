// Generated by IOTIFT - ESP32 Arduino Production Ready
// Target: esp32

#include "Arduino.h"


// ────────── Pin Definitions ──────────
#define BTN_PIN 4
#define BUZZER_PIN 18


// ────────── Global State ──────────
int FULL_BUDGET = 30000;
int HOUR = 3600000;
int MAX_BURST = 5000;
int COOLDOWN = 2000;
int honkUsed = 0;
int lastReset = 0;
int burstStart = 0;
int lastReleaseTime = 0;
bool inBurst = false;
bool inCooldown = false;
int _last_BTN_state = HIGH;


// ────────── Handlers ──────────
void handle_BTN_press() {
  int _state = digitalRead(BTN_PIN);
  if (_state == LOW && _last_BTN_state == HIGH) {
      inBurst = true;
      burstStart = millis();
  }
  _last_BTN_state = _state;
}

void handle_BTN_release() {
  int _state = digitalRead(BTN_PIN);
  if (_state == HIGH && _last_BTN_state == LOW) {
      if (inBurst) {
        inBurst = false;
        inCooldown = true;
        lastReleaseTime = millis();
      }
      digitalWrite(BUZZER_PIN, LOW);
  }
  _last_BTN_state = _state;
}


// ────────── Setup ──────────
void setup() {
  Serial.begin(115200);
  pinMode(BTN_PIN, INPUT_PULLUP);
  pinMode(BUZZER_PIN, OUTPUT);
  
      lastReset = millis();
  
}


// ────────── Main Loop ──────────
void loop() {
  handle_BTN_press();
  handle_BTN_release();
  
      unsigned long now = millis();
  
      if (now - lastReset >= HOUR) {
          honkUsed  = 0;
          lastReset = now;
      }
  
      if (inCooldown) {
          if (now - lastReleaseTime >= COOLDOWN) {
              inCooldown = false;
          } else {
              digitalWrite(BUZZER_PIN, LOW);
              return;
          }
      }
  
      if (inBurst) {
          if (now - burstStart >= MAX_BURST) {
              inBurst         = false;
              inCooldown      = true;
              lastReleaseTime = now;
              digitalWrite(BUZZER_PIN, LOW);
              return;
          }
  
          if (honkUsed < FULL_BUDGET) {
              digitalWrite(BUZZER_PIN, HIGH);
              honkUsed += 10;
          } else {
              digitalWrite(BUZZER_PIN, LOW);
          }
      } else {
          digitalWrite(BUZZER_PIN, LOW);
      }
  
  yield();
}
